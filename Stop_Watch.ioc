# file: Stop_Watch.ioc
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Mcu.Family=STM32F1
Mcu.Name=STM32F103C(8-B)Tx
Mcu.Package=LQFP48
NVIC.PriorityGroup=NVIC_PRIORITYGROUP_4
PA13.Mode=Serial_Wire
PA13.Signal=SYS_JTMS-SWDIO
PA14.Mode=Serial_Wire
PA14.Signal=SYS_JTCK-SWCLK
PD0-OSC_IN.Mode=HSE-External-Oscillator
PD0-OSC_IN.Signal=RCC_OSC_IN
PD1-OSC_OUT.Mode=HSE-External-Oscillator
PD1-OSC_OUT.Signal=RCC_OSC_OUT
ProjectManager.HeapSize=0x200
ProjectManager.StackSize=0x400
ProjectManager.TargetToolchain=STM32CubeIDE
RCC.AHBFreq_Value=72000000
RCC.APB1CLKDivider=RCC_HCLK_DIV2
RCC.APB1Freq_Value=36000000
RCC.APB1TimFreq_Value=72000000
RCC.APB2Freq_Value=72000000
RCC.APB2TimFreq_Value=72000000
RCC.HCLKFreq_Value=72000000
RCC.PLLMUL=RCC_PLL_MUL9
RCC.PLLSourceVirtual=RCC_PLLSOURCE_HSE
RCC.SYSCLKFreq_VALUE=72000000
RCC.SYSCLKSource=RCC_SYSCLKSOURCE_PLLCLK
RCC.USBFreq_Value=72000000
board=custom

// file: Core/Src/main.c
/* USER CODE BEGIN Header */
/**
  ******************************************************************************
  * @file           : main.c
  * @brief          : Main program body
  ******************************************************************************
  * @attention
  *
  * Copyright (c) 2024 STMicroelectronics.
  * All rights reserved.
  *
  * This software is licensed under terms that can be found in the LICENSE file
  * in the root directory of this software component.
  * If no LICENSE file comes with this software, it is provided AS-IS.
  *
  ******************************************************************************
  */
/* USER CODE END Header */
#include "main.h"

/* USER CODE BEGIN Includes */
#include <stdio.h>
/* USER CODE END Includes */

/* USER CODE BEGIN PV */
Matrix_Keypad_t keypad = {
		.Columns = 4,
		.IntputPort = GPIOB,
		.InputStartingPin = 6,
		.Rows = 4,
		.OutputPort = GPIOB,
		.OutputStartingPin = 12
};

Alcd_t lcd = {
		.Data_GPIO = GPIOA ,
		.Data_GPIO_Start_Pin = 0 ,
		.RS_GPIO = GPIOA,
		.RS_GPIO_Pin = GPIO_PIN_4,
		.EN_GPIO = GPIOA,
		.EN_GPIO_Pin = GPIO_PIN_5
};

char str [16];
uint8_t HH,MM,SS,mS = 0;
uint8_t len;
/* USER CODE END PV */

void SystemClock_Config(void);
static void MX_GPIO_Init(void);

int main(void)
{

  /* MCU Configuration--------------------------------------------------------*/

  /* Reset of all peripherals, Initializes the Flash interface and the Systick. */
  HAL_Init();

  /* Configure the system clock */
  SystemClock_Config();

  /* Initialize all configured peripherals */
  MX_GPIO_Init();
  /* USER CODE BEGIN 2 */

  __HAL_RCC_GPIOB_CLK_ENABLE();

  Keypad_Init(&keypad);
  Alcd_Init(&lcd, 2, 16);
  Alcd_PutAt(&lcd, 0, 0, "Hi, Stop Watch..");
  HAL_Delay(2000);
  Alcd_PutAt(&lcd, 1, 0, "let's begin...");
  HAL_Delay(2000);
  Alcd_PutAt(&lcd, 0, 0, "_____Rules______");
  Alcd_PutAt(&lcd, 1, 0, "Press B to Stop");
  HAL_Delay(3000);
  Alcd_PutAt(&lcd, 1, 0, "Press C to Reset");
  HAL_Delay(3000);
  Alcd_PutAt(&lcd, 1, 0, "Press A to Start");
  HAL_Delay(3000);
  Alcd_PutAt(&lcd, 0, 0, "let's start.....");

  uint8_t flag_start = 0;

  /* USER CODE END 2 */

  /* Infinite loop */
  while (1)
  {

      // Refresh the keypad to get the latest input
      Keypad_Refresh(&keypad);

      // Check if the 'Start' button (Button A) is pressed
      if (Keypad_Get_Key(&keypad, 3))
      {
    	  if(flag_start == 0){
    		  Alcd_Clear(&lcd);
    	  }
          // Set the flag indicating the stop-watch has started
          flag_start = 1;

          // Display a message indicating the user can stop the stop-watch or reset it
          Alcd_PutAt(&lcd, 1, 0, "B Stop - C Reset");
      }

      // Check if the stop-watch is already running
      if (flag_start == 1)
      {
          // Format the time string and display it on the LCD
          len = sprintf(str, "%02d:%02d:%02d.%02d", HH, MM, SS, mS);
          Alcd_PutAt_n(&lcd, 0, 0, str, len);

          // Update time variables
          mS++;
          if (mS == 100)	//update every 1 sec
          {
              SS++;
              mS = 0;
          }
          if (SS == 60)		//update every 1 min
          {
              MM++;
              SS = 0;
          }
          if (MM == 60)		//update every 1 hr
          {
              HH++;
              MM = 0;
          }
          if (HH == 24)		//update every 1 day
          {
              MM = 0;
              HH = 0;
              SS = 0;
          }
      }

      // Check if the 'Stop' button (Button B) is pressed
      if (Keypad_Get_Key(&keypad, 7) && flag_start == 1)
      {
          // Format the time string and display it on the LCD
          len = sprintf(str, "%02d:%02d:%02d.%02d", HH, MM, SS, mS);
          Alcd_PutAt_n(&lcd, 0, 0, str, len);

          // Display a message indicating the user can start the stop-watch again or reset it
          Alcd_PutAt(&lcd, 1, 0, "A Play - C Reset");

          // Reset the 'Start' flag and set the 'Stop' flag
          flag_start = 0;
      }

      // Check if the 'Reset' button (Button C) is pressed
      if (Keypad_Get_Key(&keypad, 11))
      {
          // Reset all time variables to zero
          HH = MM = SS = mS = 0;

          // Format the time string and display it on the LCD
          len = sprintf(str, "%02d:%02d:%02d.%02d", HH, MM, SS, mS);
          Alcd_PutAt_n(&lcd, 0, 0, str, len);

          // Display a message indicating the user can start the stopwatch or stop it
          Alcd_PutAt(&lcd, 1, 0, "A Start - B Stop");

          // Reset both 'Start' and 'Stop' flags
          flag_start = 0;
      }

  }
}

void SystemClock_Config(void)
{
  RCC_OscInitTypeDef RCC_OscInitStruct = {0};
  RCC_ClkInitTypeDef RCC_ClkInitStruct = {0};

  /** Initializes the RCC Oscillators according to the specified parameters
  * in the RCC_OscInitTypeDef structure.
  */
  RCC_OscInitStruct.OscillatorType = RCC_OSCILLATORTYPE_HSE;
  RCC_OscInitStruct.HSEState = RCC_HSE_ON;
  RCC_OscInitStruct.HSEPredivValue = RCC_HSE_PREDIV_DIV1;
  RCC_OscInitStruct.HSIState = RCC_HSI_ON;
  RCC_OscInitStruct.PLL.PLLState = RCC_PLL_ON;
  RCC_OscInitStruct.PLL.PLLSource = RCC_PLLSOURCE_HSE;
  RCC_OscInitStruct.PLL.PLLMUL = RCC_PLL_MUL9;
  if (HAL_RCC_OscConfig(&RCC_OscInitStruct) != HAL_OK)
  {
    Error_Handler();
  }

  /** Initializes the CPU, AHB and APB buses clocks
  */
  RCC_ClkInitStruct.ClockType = RCC_CLOCKTYPE_HCLK|RCC_CLOCKTYPE_SYSCLK
                              |RCC_CLOCKTYPE_PCLK1|RCC_CLOCKTYPE_PCLK2;
  RCC_ClkInitStruct.SYSCLKSource = RCC_SYSCLKSOURCE_PLLCLK;
  RCC_ClkInitStruct.AHBCLKDivider = RCC_SYSCLK_DIV1;
  RCC_ClkInitStruct.APB1CLKDivider = RCC_HCLK_DIV2;
  RCC_ClkInitStruct.APB2CLKDivider = RCC_HCLK_DIV1;

  if (HAL_RCC_ClockConfig(&RCC_ClkInitStruct, FLASH_LATENCY_2) != HAL_OK)
  {
    Error_Handler();
  }
}

static void MX_GPIO_Init(void)
{

  /* GPIO Ports Clock Enable */
  __HAL_RCC_GPIOD_CLK_ENABLE();
  __HAL_RCC_GPIOA_CLK_ENABLE();

}

void Error_Handler(void)
{
  __disable_irq();
  while (1)
  {
  }
}
